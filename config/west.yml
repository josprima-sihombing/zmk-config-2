## config/west.yml
```yaml
manifest:
  defaults:
    revision: v0.3
  remotes:
    - name: zmkfirmware
      url-base: https://github.com/zmkfirmware
    # Additional modules containing boards/shields/custom code can be listed here as well
    # See https://docs.zephyrproject.org/3.2.0/develop/west/manifest.html#projects
    - name: miryoku_base
      url-base: https://github.com/manna-harbour/miryoku_zmk
  projects:
    - name: zmk
      remote: zmkfirmware
      import: app/west.yml
    - name: miryoku
      remote: miryoku_base
      revision: master
  self:
    path: config
```
